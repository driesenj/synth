#include "SSD1306.h"

/* ── Internal state ──────────────────────────────────────────────────────── */
static I2C_HandleTypeDef *_hi2c;

/* [page][0] is the 0x40 control byte; [page][1..128] are the pixels.
   Laid out this way so each page can be handed straight to the DMA. */
static uint8_t _page[SSD1306_PAGES][1 + SSD1306_WIDTH];

static volatile uint8_t _dma_busy  = 0;
static volatile uint8_t _page_next = SSD1306_PAGES;   /* == PAGES → frame done */

/* ── Low-level helpers ───────────────────────────────────────────────────── */

/* Send a single command byte */
static void _cmd(uint8_t cmd)
{
    uint8_t buf[2] = { 0x00, cmd }; // Co=0, D/C#=0
    HAL_I2C_Master_Transmit(_hi2c, SSD1306_I2C_ADDR << 1, buf, 2, HAL_MAX_DELAY);
}

/* ── Initialisation sequence (SSD1306 datasheet §8.5) ───────────────────── */
void SSD1306_Init(I2C_HandleTypeDef *hi2c)
{
    _hi2c = hi2c;
    HAL_Delay(10); // give the display time to power up

    _cmd(0xAE); // display OFF

    _cmd(0xD5); // set display clock divide ratio / oscillator frequency
    _cmd(0x80);

    _cmd(0xA8); // set multiplex ratio
    _cmd(SSD1306_HEIGHT - 1);

    _cmd(0xD3); // set display offset
    _cmd(0x00);

    _cmd(0x40); // set display start line = 0

    _cmd(0x8D); // charge pump setting
    _cmd(0x14); // enable internal charge pump

    _cmd(0x20); // memory addressing mode
    _cmd(0x00); // horizontal addressing

    _cmd(0xA1); // segment re-map: col 127 → SEG0
    _cmd(0xC8); // COM output scan direction: remapped

    _cmd(0xDA); // set COM pins hardware configuration
    _cmd(0x12); // alternative COM pin config, disable COM left/right remap

    _cmd(0x81); // set contrast
    _cmd(0xCF);

    _cmd(0xD9); // set pre-charge period
    _cmd(0xF1);

    _cmd(0xDB); // set VCOMH deselect level
    _cmd(0x40);

    _cmd(0xA4); // entire display on: follow RAM content
    _cmd(0xA6); // set normal display (not inverted)

    SSD1306_Fill(0);
	/* One synchronous frame so the display starts from a known state. This runs
	   before the transport is started, so blocking here is fine. */
	_cmd(0x21); _cmd(0); _cmd(SSD1306_WIDTH - 1);
	_cmd(0x22); _cmd(0); _cmd(SSD1306_PAGES - 1);
	for (uint8_t p = 0; p < SSD1306_PAGES; p++)
		HAL_I2C_Master_Transmit(_hi2c, SSD1306_I2C_ADDR << 1,
								_page[p], 1 + SSD1306_WIDTH, HAL_MAX_DELAY);

	_cmd(0xAF); // display ON
}

/* ── Frame-buffer operations ─────────────────────────────────────────────── */

void SSD1306_Fill(uint8_t colour)
{
	for (uint8_t p = 0; p < SSD1306_PAGES; p++) {
		_page[p][0] = 0x40;
		memset(&_page[p][1], colour ? 0xFF : 0x00, SSD1306_WIDTH);
	}
}

void SSD1306_DrawPixel(int16_t x, int16_t y, uint8_t colour)
{
	if ((uint16_t)x >= SSD1306_WIDTH || (uint16_t)y >= SSD1306_HEIGHT) return;

	uint8_t *byte = &_page[y >> 3][1 + x];
	uint8_t  mask = (uint8_t)(1u << (y & 7));

	if (colour) *byte |=  mask;
	else        *byte &= (uint8_t)~mask;
}

void SSD1306_DrawHLine(int16_t x, int16_t y, int16_t w, uint8_t colour)
{
    for (int16_t i = 0; i < w; i++)
        SSD1306_DrawPixel(x + i, y, colour);
}

void SSD1306_DrawVLine(int16_t x, int16_t y, int16_t h, uint8_t colour)
{
    for (int16_t i = 0; i < h; i++)
        SSD1306_DrawPixel(x, y + i, colour);
}

void SSD1306_FillRect(int16_t x, int16_t y, int16_t w, int16_t h, uint8_t colour)
{
    for (int16_t row = 0; row < h; row++)
        SSD1306_DrawHLine(x, y + row, w, colour);
}

/* ── Built-in 5×7 ASCII font (space = 0x20 … tilde = 0x7E) ─────────────── */
static const uint8_t _font5x7[][5] = {
    {0x00,0x00,0x00,0x00,0x00}, // ' '
    {0x00,0x00,0x5F,0x00,0x00}, // '!'
    {0x00,0x07,0x00,0x07,0x00}, // '"'
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    {0x08,0x08,0x2A,0x1C,0x08}, // '~'
};

void SSD1306_DrawChar(int16_t x, int16_t y, char ch, uint8_t colour)
{
    if (ch < 0x20 || ch > 0x7E) ch = '?';
    const uint8_t *glyph = _font5x7[ch - 0x20];

    for (uint8_t col = 0; col < 5; col++) {
        uint8_t line = glyph[col];
        for (uint8_t row = 0; row < 7; row++) {
            if (line & (1 << row))
                SSD1306_DrawPixel(x + col, y + row, colour);
            else
                SSD1306_DrawPixel(x + col, y + row, !colour);
        }
    }
}

void SSD1306_DrawString(int16_t x, int16_t y, const char *str, uint8_t colour)
{
    int16_t cx = x, cy = y;
    while (*str) {
        if (cx + 6 > SSD1306_WIDTH) { // wrap
            cx = 0;
            cy += 9; // 7px glyph + 2px gap
        }
        if (cy + 7 > SSD1306_HEIGHT) break; // off-screen, stop
        SSD1306_DrawChar(cx, cy, *str++, colour);
        cx += 6; // 5px glyph + 1px gap
    }
}

uint8_t SSD1306_UpdateStart(void)
{
    if (_dma_busy || _page_next < SSD1306_PAGES) return 0;   /* still sending */

    /* Reset the GDDRAM window. Blocking, 6 × 2 bytes ≈ 150 µs. Horizontal
       addressing mode was set in Init, so the pointer auto-increments and
       wraps across all eight strips without further commands. */
    _cmd(0x21); _cmd(0); _cmd(SSD1306_WIDTH - 1);
    _cmd(0x22); _cmd(0); _cmd(SSD1306_PAGES - 1);

    _page_next = 0;
    SSD1306_Service();
    return 1;
}

void SSD1306_Service(void)
{
    if (_dma_busy) return;
    if (_page_next >= SSD1306_PAGES) return;

    uint8_t p = _page_next;
    _dma_busy = 1;

    if (HAL_I2C_Master_Transmit_DMA(_hi2c, SSD1306_I2C_ADDR << 1,
                                    _page[p], 1 + SSD1306_WIDTH) != HAL_OK) {
        _dma_busy = 0;          /* bus busy or error — retry next iteration */
        return;
    }
    _page_next = (uint8_t)(p + 1);
}

uint8_t SSD1306_BusBusy(void)    { return _dma_busy; }
uint8_t SSD1306_UpdateBusy(void) { return _dma_busy || (_page_next < SSD1306_PAGES); }

void SSD1306_TxCpltISR(void) { _dma_busy = 0; }

void SSD1306_ErrorISR(void)
{
    _dma_busy  = 0;
    _page_next = SSD1306_PAGES;    /* abandon the frame; next redraw retries */
}
